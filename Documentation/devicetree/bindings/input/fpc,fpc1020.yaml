## Documentation/devicetree/bindings/input/fpc,fpc1020.yaml
```yaml
# SPDX-License-Identifier: (GPL-2.0-only OR BSD-2-Clause)
%YAML 1.2
---
$id: http://devicetree.org/schemas/input/fpc,fpc1020.yaml#
$schema: http://devicetree.org/meta-schemas/core.yaml#

title: Fingerprint Cards SPI fingerprint sensor control interface

maintainers:
  - reisa <reisa8366@gmail.com>

description:
  Fingerprint Cards capacitive fingerprint sensors connected via SPI.
  The existing fpc,fpc1020 compatible is also used for the FPC1264 sensor
  on the Xiaomi Pad 6 Pro. Biometric processing runs in the OEM trusted
  application; this interface controls the sensor and transports SPI data.

allOf:
  - $ref: /schemas/spi/spi-peripheral-props.yaml#

properties:
  compatible:
    const: fpc,fpc1020

  reg:
    maxItems: 1

  spi-max-frequency: true

  interrupts:
    maxItems: 1

  reset-gpios:
    maxItems: 1

  vdd-supply:
    description: Power supply regulator for VDD pin.

  pinctrl-names:
    items:
      - const: default

required:
  - compatible
  - reg
  - spi-max-frequency
  - interrupts

unevaluatedProperties: false

examples:
  - |
    #include <dt-bindings/interrupt-controller/irq.h>
    #include <dt-bindings/gpio/gpio.h>

    spi {
        #address-cells = <1>;
        #size-cells = <0>;

        fingerprint@0 {
            compatible = "fpc,fpc1020";
            reg = <0>;
            spi-max-frequency = <8000000>;
            interrupts = <40 IRQ_TYPE_EDGE_RISING>;
            reset-gpios = <&tlmm 41 GPIO_ACTIVE_LOW>;
            vdd-supply = <&pm8350c_l9>;
        };
    };
```

## Documentation/devicetree/bindings/input/fpc,fpc1264-tee.yaml
```yaml
# SPDX-License-Identifier: (GPL-2.0-only OR BSD-2-Clause)
%YAML 1.2
---
$id: http://devicetree.org/schemas/input/fpc,fpc1264-tee.yaml#
$schema: http://devicetree.org/meta-schemas/core.yaml#

title: Fingerprint Cards FPC1264 GPIO control for an OEM trusted application

maintainers:
  - reisa <reisa8366@gmail.com>

description: |
  Normal-world power, active-low reset and IRQ control for an FPC1264 sensor
  whose SPI bus is managed by a trusted application. This is a platform device,
  not a child of a Linux SPI controller. The binding does not grant normal-world
  ownership of the SPI bus. Supply voltage constraints belong to the board.

properties:
  compatible:
    const: fpc,fpc1264-tee

  reset-gpios:
    maxItems: 1
    description: Active-low sensor reset line.

  interrupts:
    maxItems: 1
    description: Sensor event interrupt.

  vdd-supply:
    description: Sensor power supply.

required:
  - compatible
  - reset-gpios
  - interrupts
  - vdd-supply

additionalProperties: false

examples:
  - |
    #include <dt-bindings/gpio/gpio.h>
    #include <dt-bindings/interrupt-controller/irq.h>

    fingerprint {
        compatible = "fpc,fpc1264-tee";
        interrupt-parent = <&tlmm>;
        interrupts = <40 IRQ_TYPE_EDGE_RISING>;
        reset-gpios = <&tlmm 41 GPIO_ACTIVE_LOW>;
        vdd-supply = <&fingerprint_vdd>;
    };
```

## Documentation/devicetree/bindings/media/i2c/smartsens,sc202cs.yaml
```yaml
# SPDX-License-Identifier: (GPL-2.0-only OR BSD-2-Clause)
%YAML 1.2
---
$id: http://devicetree.org/schemas/media/i2c/smartsens,sc202cs.yaml#
$schema: http://devicetree.org/meta-schemas/core.yaml#

title: SmartSens SC202CS Image Sensor

description:
  The SmartSens SC202CS is a 2MP depth image sensor.  It is controlled over
  a serial camera control bus and outputs RAW10 data over a single-lane
  MIPI D-PHY interface.

maintainers:
  - Linux Media maintainers <linux-media@vger.kernel.org>

allOf:
  - $ref: /schemas/media/video-interface-devices.yaml#

properties:
  compatible:
    const: smartsens,sc202cs

  reg:
    maxItems: 1

  clocks:
    description: 19.2 MHz sensor master clock.
    maxItems: 1

  clock-names:
    items:
      - const: xvclk

  reset-gpios:
    description: Active low GPIO connected to the RESET pad of the sensor.
    maxItems: 1

  vdda-supply:
    description: Optional analogue sensor supply.

  vddd-supply:
    description: Optional digital core supply.

  vddio-supply:
    description: Optional digital I/O supply.

  port:
    $ref: /schemas/graph.yaml#/$defs/port-base
    additionalProperties: false

    properties:
      endpoint:
        $ref: /schemas/media/video-interfaces.yaml#
        unevaluatedProperties: false

        properties:
          clock-lanes:
            maxItems: 1

          data-lanes:
            minItems: 1
            maxItems: 4

          link-frequencies:
            minItems: 1

        required:
          - data-lanes
          - link-frequencies

required:
  - compatible
  - reg
  - clocks
  - clock-names
  - port

unevaluatedProperties: false

examples:
  - |
    #include <dt-bindings/gpio/gpio.h>

    i2c {
        #address-cells = <1>;
        #size-cells = <0>;

        camera@36 {
            compatible = "smartsens,sc202cs";
            reg = <0x36>;
            clocks = <&camcc 0>;
            clock-names = "xvclk";
            assigned-clocks = <&camcc 0>;
            assigned-clock-rates = <19200000>;
            reset-gpios = <&tlmm 24 GPIO_ACTIVE_LOW>;
            vdda-supply = <&vreg_2p8>;
            vddio-supply = <&vreg_1p8>;

            port {
                endpoint {
                    clock-lanes = <0>;
                    data-lanes = <1>;
                    link-frequencies = /bits/ 64 <360000000>;
                    remote-endpoint = <&mipi_csi2_ep>;
                };
            };
        };
    };
...
```

## Documentation/devicetree/bindings/media/i2c/sony,imx596.yaml
```yaml
# SPDX-License-Identifier: (GPL-2.0 OR BSD-2-Clause)
%YAML 1.2
---
$id: http://devicetree.org/schemas/media/i2c/sony,imx596.yaml#
$schema: http://devicetree.org/meta-schemas/core.yaml#

title: Sony IMX596 CMOS Image Sensor

maintainers:
  - Linux Media maintainers <linux-media@vger.kernel.org>

description: |-
  The Sony IMX596 is a CMOS active pixel image sensor, used as the 20 MP
  front camera on the Xiaomi Pad 6 Pro (Liuqin). It is programmable through
  I2C and outputs raw Bayer frames over a four-lane MIPI CSI-2 interface.

allOf:
  - $ref: /schemas/media/video-interface-devices.yaml#

properties:
  compatible:
    const: sony,imx596

  reg:
    maxItems: 1

  clocks:
    description: 19.2 MHz sensor master clock (XVCLK).
    maxItems: 1

  clock-names:
    items:
      - const: xvclk

  reset-gpios:
    description: Sensor reset (XCLR) GPIO.
    maxItems: 1

  vdda-supply:
    description: Optional analogue sensor supply.

  vddd-supply:
    description: Optional digital core supply.

  vddio-supply:
    description: Optional digital I/O supply.

  port:
    $ref: /schemas/graph.yaml#/$defs/port-base
    additionalProperties: false

    properties:
      endpoint:
        $ref: /schemas/media/video-interfaces.yaml#
        unevaluatedProperties: false

        properties:
          clock-lanes:
            maxItems: 1

          data-lanes:
            items:
              - const: 1
              - const: 2
              - const: 3
              - const: 4

        required:
          - data-lanes
          - link-frequencies

    required:
      - endpoint

required:
  - compatible
  - reg
  - clocks
  - clock-names
  - port

unevaluatedProperties: false

examples:
  - |
    #include <dt-bindings/clock/qcom,sm8450-camcc.h>
    #include <dt-bindings/gpio/gpio.h>

    i2c {
        #address-cells = <1>;
        #size-cells = <0>;

        camera@10 {
            compatible = "sony,imx596";
            reg = <0x10>;
            clocks = <&camcc CAM_CC_MCLK5_CLK>;
            clock-names = "xvclk";
            reset-gpios = <&tlmm 127 GPIO_ACTIVE_LOW>;
            vdda-supply = <&camera_front_avdd_ldo>;
            vddd-supply = <&camera_front_vdig_ldo>;
            vddio-supply = <&pm8350c_l1>;
            orientation = <0>;

            port {
                imx596_out: endpoint {
                    clock-lanes = <0>;
                    data-lanes = <1 2 3 4>;
                    link-frequencies = /bits/ 64 <678400000>;
                    remote-endpoint = <&camss_in2>;
                };
            };
        };
    };
...
```
